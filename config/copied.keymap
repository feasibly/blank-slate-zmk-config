/*
 * Copyright (c) 2022 Pete Johanson
 *
 * SPDX-License-Identifier: MIT
 */

#include <behaviors.dtsi>
#include <dt-bindings/zmk/keys.h>
#include <dt-bindings/zmk/bt.h>
#include <dt-bindings/zmk/outputs.h>

  / {
    keymap {
      compatible = "zmk,keymap";
  layer0 {
          bindings = <
          &kp TAB &kp Q &kp W &kp E &kp R &kp T &kp Y &kp U &kp I &kp O &kp P &kp BACKSPACE MT(MOD_LCTL,KC_ESC) &kp A &kp S &kp D &kp F &kp G &kp H &kp J &kp K &kp L &kp SEMICOLON &kp SINGLE_QUOTE &kp LEFT_SHIFT &kp Z &kp X &kp C &kp V &kp B &kp N &kp M &kp COMMA &kp DOT &kp SLASH &lt 3 ENTER C(S(A(LCA(MEH(LWIN(SWIN(LCAG(HYPR(KC_4))))))))) &kp LEFT_CONTROL &kp LEFT_ALT &kp LEFT_GUI &lt 1 KP_MINUS &kp SPACE &kp SPACE &lt 2 KP_PLUS &kp LEFT &kp DOWN &kp UP &kp RIGHT &kp PRINTSCREEN &kp LEFT_GUI &kp F20 &kp LEFT_ALT TT(1) &kp F20 &kp F20 SPC_FN2 &kp LEFT_BRACKET &kp F20 &kp RIGHT_BRACKET &kp CAPSLOCK
          >;
        };layer1 {
          bindings = <
          KC_TILD KC_EXLM KC_AT KC_HASH KC_DLR KC_PERC KC_CIRC KC_AMPR KC_ASTR KC_LPRN KC_RPRN &trans &trans &trans &trans &trans &trans &trans &trans LWIN(KC_LBRC) LWIN(KC_RBRC) KC_LCBR KC_RCBR KC_PIPE &trans &trans &trans &trans &trans &trans &trans &trans &trans &trans &trans &trans &trans &trans &trans &trans &trans &trans &trans &mo 3 &trans &trans &trans &trans &kp ESCAPE C(A(LCA(KC_DEL))) &kp F20 C(S(KC_ESC)) &trans &kp F20 &kp F20 &trans &kp NON_US_BACKSLASH &kp F20 &kp GRAVE &trans
          >;
        };layer2 {
          bindings = <
          &kp GRAVE &kp N1 &kp N2 &kp N3 &kp N4 &kp N5 &kp N6 &kp N7 &kp N8 &kp N9 &kp N0 &trans &trans &trans &trans &trans &trans &trans &trans &kp MINUS &kp EQUAL &kp LEFT_BRACKET &kp RIGHT_BRACKET &kp BACKSLASH &trans &trans &trans &trans &trans &trans &trans &trans &trans &trans &trans &trans &trans &trans &trans &trans &mo 3 &trans &trans &trans &kp C_PLAY_PAUSE &kp C_VOLUME_DOWN &kp C_MUTE &kp C_VOLUME_UP RESET &trans &kp F20 &trans &trans &kp F20 &kp F20 &trans &trans &kp F20 &trans &trans
          >;
        };layer3 {
          bindings = <
          &trans &trans C(S(A(LCA(MEH(LWIN(SWIN(LCAG(HYPR(KC_5))))))))) C(S(A(LCA(MEH(LWIN(SWIN(LCAG(HYPR(KC_3))))))))) C(S(A(LCA(MEH(LWIN(SWIN(LCAG(HYPR(KC_6))))))))) &trans &trans &trans &trans &trans &trans &kp DELETE &trans &trans C(S(A(LCA(MEH(LWIN(SWIN(LCAG(HYPR(KC_1))))))))) C(S(A(LCA(MEH(LWIN(SWIN(LCAG(HYPR(KC_9))))))))) C(S(A(LCA(MEH(LWIN(SWIN(LCAG(HYPR(KC_2))))))))) &trans &trans &kp C_SLEEP &trans &kp UP &trans &trans &trans &trans C(S(A(LCA(MEH(LWIN(SWIN(LCAG(HYPR(KC_7))))))))) C(S(A(LCA(MEH(LWIN(SWIN(LCAG(HYPR(KC_GRV))))))))) C(S(A(LCA(MEH(LWIN(SWIN(LCAG(HYPR(KC_8))))))))) &trans &trans &trans &kp LEFT &kp DOWN &kp RIGHT &trans &trans &trans &trans &trans &trans &trans &trans &trans &trans &trans &trans &trans A(KC_GRV) S(A(KC_B)) LWIN(KC_D) S(LWIN(SWIN(KC_F))) A(LWIN(KC_H)) S(A(LWIN(SWIN(KC_J)))) (KC_L S(RSFT(KC_N)) A(ALGR(KC_P)) S(A(RSFT(ALGR(KC_R)))) LWIN(RWIN(KC_T)) S(LWIN(SWIN(RSFT(RWIN(KC_V)))))
          >;
        };
    };
  };
  
